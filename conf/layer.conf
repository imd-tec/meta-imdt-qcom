## conf/layer.conf
```bitbake
# We have a conf and classes directory, add to BBPATH
BBPATH .= ":${LAYERDIR}"

# We have recipes-* directories, add to BBFILES
BBFILES += "${LAYERDIR}/recipes-*/*/*.bb \
            ${LAYERDIR}/recipes-*/*/*.bbappend"

BBFILE_COLLECTIONS += "meta-imdt-qcom"
BBFILE_PATTERN_meta-imdt-qcom = "^${LAYERDIR}/"
BBFILE_PRIORITY_meta-imdt-qcom = "25"

LAYERDEPENDS_meta-imdt-qcom = "core"
LAYERSERIES_COMPAT_meta-imdt-qcom = "kirkstone"

# This should only be incremented on significant changes that will
# cause compatibility issues with other layers
LAYERVERSION_meta-imdt-qcom = "1"
```
